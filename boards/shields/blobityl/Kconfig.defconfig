## boards/shields/blobityl/Kconfig.defconfig
```kconfig
if SHIELD_BLOBITYL_LEFT

config ZMK_KEYBOARD_NAME
    default "Blobityl"

config ZMK_SPLIT_ROLE_CENTRAL
    default y

endif

if SHIELD_BLOBITYL_LEFT || SHIELD_BLOBITYL_RIGHT

config ZMK_SPLIT
    default y

endif
```

## boards/shields/blobityl/Kconfig.shield
```kconfig
config SHIELD_BLOBITYL_LEFT
    def_bool $(shields_list_contains,blobityl_left)

config SHIELD_BLOBITYL_RIGHT
    def_bool $(shields_list_contains,blobityl_right)
```
